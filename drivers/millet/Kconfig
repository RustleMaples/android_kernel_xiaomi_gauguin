## drivers/millet/Kconfig
```kconfig
config MILLET
	bool "Xiaomi Millet frozen framework"
	default n
	help
	  Xiaomi Millet background process freezer and monitor framework.
```

## drivers/staging/mi_metis/Kconfig
```kconfig
config MI_METIS
	bool "Xiaomi Metis compatibility driver"
	default n
	help
	  Expose /dev/metis and /sys/module/metis/parameters/* for HyperOS userspace compatibility.
```
